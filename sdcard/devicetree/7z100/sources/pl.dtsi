/*
 * CAUTION: This file is automatically generated by Xilinx.
 * Version: HSI 
 * Today is: Fri Dec 18 11:24:09 2015
*/


/ {
	amba_pl: amba_pl {
		#address-cells = <1>;
		#size-cells = <1>;
		compatible = "simple-bus";
		ranges ;

    hwacc@43c10000 {
      compatible = "hwacc";
			reg = <0x43c10000 0x100>;
      interrupts = <0 29 4>, <0 30 4>;
			interrupt-parent = <0x3>;
    };

    xilcam@43000000 {
      compatible = "xilcam";
      reg = <0x43000000 0x20>;
      interrupts = <0 31 4>;
			interrupt-parent = <0x3>;
    };

	};
};
